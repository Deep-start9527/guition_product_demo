## demo_ESP-IDF/general/ble/components/guition/esp32_4827s043/sdkconfig.defaults.board
```kconfig
# ESP32-S3 OPI PSRAM; keep 80 MHz flash conservative for the 120 MHz Arduino variants.
CONFIG_SPIRAM=y
CONFIG_SPIRAM_MODE_OCT=y
CONFIG_SPIRAM_SPEED_80M=y
CONFIG_SPIRAM_USE_MALLOC=y
CONFIG_ESPTOOLPY_FLASHMODE_QIO=y
CONFIG_ESPTOOLPY_FLASHFREQ_80M=y
CONFIG_ESP_DEFAULT_CPU_FREQ_MHZ_240=y
CONFIG_ESP_BOARD_DEV_DISPLAY_LCD_SUPPORT=y
CONFIG_ESP_BOARD_DEV_CUSTOM_SUPPORT=y
CONFIG_ESPTOOLPY_FLASHSIZE_16MB=y
CONFIG_ESP_BOARD_DEV_DISPLAY_LCD_SUB_RGB_SUPPORT=y
CONFIG_ESP_BOARD_PERIPH_GPIO_SUPPORT=y
CONFIG_ESP_BOARD_DEV_GPIO_CTRL_SUPPORT=y
CONFIG_XPT2046_Z_THRESHOLD=400
CONFIG_XPT2046_CONVERT_ADC_TO_COORDS=y
```

## demo_ESP-IDF/general/ble/components/guition/jc1060p470_i_w_y/Kconfig.projbuild
```kconfig
# SPDX-License-Identifier: MIT
if ESP_BOARD_JC1060P470_I_W_Y && IDF_TARGET_ESP32P4

menu "Guition JC1060P470 display"

config GUITION_JC1060_LCD_V2_AVAILABLE
    bool
    default n

choice GUITION_JC1060_LCD_TYPE
    prompt "LCD variant"
    default GUITION_JC1060_LCD_V1

config GUITION_JC1060_LCD_V1
    bool "LCD V1 (existing JD9165 screen)"

config GUITION_JC1060_LCD_V2
    bool "LCD V2 (reserved)"
    depends on GUITION_JC1060_LCD_V2_AVAILABLE

endchoice

comment "LCD V2 reserved: initialization commands pending"
    depends on !GUITION_JC1060_LCD_V2_AVAILABLE

endmenu

endif
```

## demo_ESP-IDF/general/ble/components/guition/jc8012p4a1/Kconfig.projbuild
```kconfig
# SPDX-License-Identifier: MIT
if ESP_BOARD_JC8012P4A1 && IDF_TARGET_ESP32P4

menu "Guition JC8012P4A1 display"

choice GUITION_JC8012_LCD_TYPE
    prompt "LCD variant"
    default GUITION_JC8012_LCD_V2
    help
        Select the physical screen. This switches both the existing JD9365
        initialization table and its matching DPI clock/video timing.

config GUITION_JC8012_LCD_V1
    bool "LCD V1 (60 MHz)"

config GUITION_JC8012_LCD_V2
    bool "LCD V2 (70 MHz, default)"

endchoice
endmenu
endif
```

## demo_ESP-IDF/general/ble/components/guition/jc8048f550/sdkconfig.defaults.board
```kconfig
CONFIG_ESP_DEFAULT_CPU_FREQ_MHZ_320=y
CONFIG_ESPTOOLPY_FLASHMODE_QIO=y
CONFIG_ESPTOOLPY_FLASHFREQ_80M=y
CONFIG_ESPTOOLPY_FLASHSIZE_16MB=y
CONFIG_SPIRAM=y
CONFIG_SPIRAM_MODE_OCT=y
CONFIG_SPIRAM_SPEED_200M=y
CONFIG_SPIRAM_XIP_FROM_PSRAM=y
CONFIG_ESP_LVGL_ADAPTER_ENABLE_FS=y
CONFIG_ESP_LVGL_ADAPTER_ENABLE_FREETYPE=y
CONFIG_ESP_LVGL_ADAPTER_FREETYPE_MINIMAL_BUILD=n
CONFIG_ESP_LVGL_ADAPTER_FREETYPE_SMALL_RENDER_POOL=y
CONFIG_LV_USE_FS_POSIX=y
CONFIG_LV_FS_POSIX_LETTER=65
CONFIG_LV_USE_FREETYPE=y
CONFIG_LV_FREETYPE_USE_LVGL_PORT=y
CONFIG_LV_FONT_SOURCE_HAN_SANS_SC_14_CJK=y
CONFIG_LV_USE_CLIB_MALLOC=y
CONFIG_LV_USE_BUILTIN_MALLOC=n
CONFIG_LV_DRAW_THREAD_STACK_SIZE=32768

# Keep the board-manager defaults from re-enabling unbounded AVRCP cover-art transfer.
CONFIG_BT_AVRCP_CT_COVER_ART_ENABLED=n

CONFIG_CODEC_ES8311_SUPPORT=n
CONFIG_CODEC_ES7210_SUPPORT=n
CONFIG_CODEC_ES7243_SUPPORT=n
CONFIG_CODEC_ES7243E_SUPPORT=n
CONFIG_CODEC_ES8156_SUPPORT=n
CONFIG_CODEC_AW88298_SUPPORT=n
CONFIG_CODEC_ES8389_SUPPORT=y
CONFIG_CODEC_ES8374_SUPPORT=n
CONFIG_CODEC_ES8388_SUPPORT=n
CONFIG_CODEC_TAS5805M_SUPPORT=n
CONFIG_CODEC_ZL38063_SUPPORT=n
CONFIG_CODEC_CJC8910_SUPPORT=n
```

## demo_ESP-IDF/general/ble/main/Kconfig.projbuild
```kconfig
menu "Guition BLE example"
config EXAMPLE_TOUCH_ENABLED
    bool "Initialize and register touch input"
    default y
config EXAMPLE_HEX_PREFIX
    bool "Show 0x before every HEX preview byte by default"
    default y
    help
        Display bytes as 0x48 0x65 instead of 48 65. Touch screens can
        change this display option at runtime; boards without touch use
        this default. This setting does not change the BLE payload.
choice EXAMPLE_SECURITY
    prompt "NUS security mode"
    default EXAMPLE_SECURITY_OPEN
config EXAMPLE_SECURITY_OPEN
    bool "No encryption required"
config EXAMPLE_SECURITY_PASSKEY
    bool "Authenticated encryption with fixed passkey"
endchoice
config EXAMPLE_PASSKEY
    int "Six digit passkey (displayed with leading zeros)"
    depends on EXAMPLE_SECURITY_PASSKEY
    range 0 999999
    default 123456
config EXAMPLE_PERIODIC_SEND
    bool "Send periodically when connected and subscribed"
    default n
config EXAMPLE_SEND_PERIOD_SECONDS
    int "Send period in seconds"
    depends on EXAMPLE_PERIODIC_SEND
    range 1 3600
    default 5
config EXAMPLE_SEND_TEXT
    string "Periodic send text (max 512 bytes)"
    default "Hello from Guition"
config EXAMPLE_COMPILE_ONLY
    bool "Compile-only P4 sample (BLE disabled at runtime)"
    depends on IDF_TARGET_ESP32P4
    default n
endmenu
```

## demo_ESP-IDF/general/ble/sdkconfig.defaults
```kconfig
# ESP-IDF v6.1
CONFIG_PARTITION_TABLE_SINGLE_APP_LARGE=y
CONFIG_LV_COLOR_DEPTH_16=y
CONFIG_LV_MEM_SIZE=65536
CONFIG_LV_USE_KEYBOARD=y
CONFIG_LV_USE_TEXTAREA=y
CONFIG_LV_USE_BUTTONMATRIX=y
# CONFIG_LV_USE_DEMO_WIDGETS is not set
# CONFIG_LV_USE_DEMO_WIDGETS_SLIDESHOW is not set
# CONFIG_LV_USE_FREETYPE is not set
# CONFIG_ESP_LVGL_ADAPTER_ENABLE_FREETYPE is not set
# CONFIG_ESP_LVGL_ADAPTER_ENABLE_FS is not set
# CONFIG_ESP_LVGL_ADAPTER_ENABLE_DECODER is not set
# CONFIG_ESP_LVGL_ADAPTER_ENABLE_BUTTON is not set
# CONFIG_ESP_LVGL_ADAPTER_ENABLE_KNOB is not set
CONFIG_BT_ENABLED=y
CONFIG_BT_NIMBLE_ENABLED=y
CONFIG_BTDM_CTRL_MODE_BLE_ONLY=y
CONFIG_BT_NIMBLE_MAX_CONNECTIONS=1
CONFIG_BT_NIMBLE_MAX_BONDS=4
CONFIG_BT_NIMBLE_NVS_PERSIST=y
CONFIG_BT_NIMBLE_ATT_PREFERRED_MTU=247
CONFIG_BT_NIMBLE_ROLE_CENTRAL=n
CONFIG_BT_NIMBLE_ROLE_OBSERVER=n
CONFIG_BT_NIMBLE_HOST_TASK_STACK_SIZE=4096
```

## demo_ESP-IDF/general/ble/sdkconfig.defaults.esp32p4
```kconfig
CONFIG_BT_ENABLED=y
CONFIG_BT_CONTROLLER_DISABLED=y
CONFIG_BT_BLUEDROID_ENABLED=n
CONFIG_BT_NIMBLE_ENABLED=y
CONFIG_BT_NIMBLE_TRANSPORT_UART=n
CONFIG_ESP_HOSTED_ENABLE_BT_NIMBLE=y
CONFIG_ESP_HOSTED_NIMBLE_HCI_VHCI=y
CONFIG_ESP_WIFI_REMOTE_LIBRARY_HOSTED=y
# CONFIG_EXAMPLE_COMPILE_ONLY is not set
```
