// SPDX-License-Identifier: MIT
// Generated by tools/guition/migrate_s3_boards.py.
#include "sdkconfig.h"
#include "esp_board_manager_includes.h"
#include "esp_board_entry.h"
#include "esp_board_manager.h"
#include "../include/guition_touch.h"
#include "esp_lcd_st7701.h"
#include "lcd_init_commands.h"

esp_err_t lcd_panel_factory_entry_t(esp_lcd_panel_io_handle_t io,
                                      const esp_lcd_panel_dev_config_t *config,
                                      esp_lcd_panel_handle_t *out)
{
    if (!config || !out) return ESP_ERR_INVALID_ARG;
    // BMGR stores the RGB configuration; the controller needs its own wrapper.
    dev_display_lcd_config_t *board = NULL;
    esp_err_t ret = esp_board_manager_get_device_config("display_lcd", (void **)&board);
    if (ret != ESP_OK) return ret;
    if (!board) return ESP_ERR_INVALID_STATE;
    st7701_vendor_config_t vendor = {
        .rgb_config = &board->sub_cfg.rgb_3wire_spi.rgb_panel_config,
        .init_cmds = guition_lcd_init_cmds,
        .init_cmds_size = sizeof(guition_lcd_init_cmds) / sizeof(guition_lcd_init_cmds[0]),
        // BMGR owns the IO through deinit. The panel must not delete it.
        .flags = { .auto_del_panel_io = 0, .mirror_by_cmd = 0 },
    };
    esp_lcd_panel_dev_config_t panel = *config;
    panel.vendor_config = &vendor;
    return esp_lcd_new_panel_st7701(io, &panel, out);
}

#if CONFIG_GUITION_TOUCH_CAPACITIVE
#include "esp_lcd_touch_gt911.h"
static esp_err_t create_capacitive(void **out)
{
    guition_touch_config_t config = {
        .mode = GUITION_TOUCH_MODE_CAPACITIVE,
        .bus = GUITION_TOUCH_BUS_I2C,
        .bus_name = "i2c_touch",
        .touch = {
            .x_max = 480, .y_max = 480,
            .rst_gpio_num = -1, .int_gpio_num = -1,
            .levels = { .reset = 0, .interrupt = 0 },
            .flags = { .swap_xy = 0, .mirror_x = 0, .mirror_y = 0 },
        },
        .factory = esp_lcd_touch_new_i2c_gt911,
    };
    config.io.i2c = (esp_lcd_panel_io_i2c_config_t)ESP_LCD_TOUCH_IO_I2C_GT911_CONFIG();
    config.io.i2c.scl_speed_hz = 400000;
    return guition_touch_bmgr_create(&config, out);
}
#endif

static esp_err_t touch_init(void *board_config, int config_size, void **out)
{
    (void)board_config;
    (void)config_size;
#if CONFIG_GUITION_TOUCH_CAPACITIVE
    return create_capacitive(out);
#elif CONFIG_GUITION_TOUCH_RESISTIVE
    return create_resistive(out);
#else
    const guition_touch_config_t config = { .mode = GUITION_TOUCH_MODE_NONE };
    return guition_touch_bmgr_create(&config, out);
#endif
}

CUSTOM_DEVICE_IMPLEMENT(lcd_touch, touch_init, guition_touch_bmgr_destroy);
